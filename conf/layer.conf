## conf/layer.conf
```bitbake
# We have a conf and classes directory, append to BBPATH
BBPATH .= ":${LAYERDIR}"

# We have a recipes directory containing .bb and .bbappend files, add to BBFILES
BBFILES += "${LAYERDIR}/recipes*/*/*.bb \
            ${LAYERDIR}/recipes*/*/*.bbappend"

BBFILE_COLLECTIONS += "sample-bsp"
BBFILE_PATTERN_sample-bsp = "^${LAYERDIR}/"
BBFILE_PRIORITY_sample-bsp = "6"

LAYERSERIES_COMPAT_sample-bsp = "scarthgap"
LAYERDEPENDS_sample-bsp = "core"
```
